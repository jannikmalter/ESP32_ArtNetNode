## sdkconfig.defaults
```kconfig
# sdkconfig.defaults — applied to every env's generated sdkconfig.<env>.
# These settings are REQUIRED for the software DMX512 bit-bang to be correct
# and are board-independent (both Olimex and WT32 builds need them).

# DMX timing: the bit-bang busy-waits 960 CPU cycles per bit. 960 cycles only
# equals one 250 kbaud bit-time (4 us) at 240 MHz, so the CPU must run at 240 MHz.
CONFIG_ESP_DEFAULT_CPU_FREQ_MHZ_240=y

# Core 1 is reserved for dmx_task, which holds a critical section forever and
# never yields to the idle task. Disable the watchdog checks on core 1 so they
# don't panic/trip; core 0 watchdogs stay enabled.
CONFIG_ESP_INT_WDT_CHECK_CPU1=n
CONFIG_ESP_TASK_WDT_CHECK_IDLE_TASK_CPU1=n

# OTA foundation (R25/R26). Use the chip's real 4 MB flash (both Olimex ESP32-POE
# and WT32-ETH01 ship 4 MB; the build previously capped it at 2 MB). The dual-slot
# OTA partition table is selected by `board_build.partitions = partitions.csv` in
# platformio.ini (PlatformIO overrides the sdkconfig partition choice), not here.
CONFIG_ESPTOOLPY_FLASHSIZE_4MB=y
CONFIG_ESPTOOLPY_FLASHSIZE="4MB"

# Roll back to the previous app slot if a freshly OTA-written image fails to come
# up. The new image boots in PENDING_VERIFY; app_main confirms it once bring-up
# succeeds (see esp_ota_mark_app_valid_cancel_rollback in src/main.c).
CONFIG_BOOTLOADER_APP_ROLLBACK_ENABLE=y

# FreeRTOS run-time stats (R29): per-task busy-time accounting so stats_task can
# compute core-0 CPU load from the core-0 idle task's run-time. esp_timer is the
# clock source. Board-independent; does not affect the cycle-counted DMX core.
CONFIG_FREERTOS_GENERATE_RUN_TIME_STATS=y
CONFIG_FREERTOS_RUN_TIME_STATS_USING_ESP_TIMER=y

# Link-local (RFC 3927) fallback when no DHCP server answers (R15) — lets the node
# work on a router-less segment (e.g. a direct PC connection). Enabling AUTOIP turns
# on lwIP's cooperative DHCP+AUTOIP mode: the DHCP client keeps running, and after
# CONFIG_LWIP_AUTOIP_TRIES failed DISCOVERs the node self-assigns a 169.254.x.x
# address; if a DHCP server later appears it takes over automatically (AUTOIP is
# dropped). Board-independent. NOTE: sdkconfig.defaults only seeds a fresh config,
# so existing sdkconfig.<env> files must be deleted to re-seed (or set this via
# menuconfig) to pick it up.
CONFIG_LWIP_AUTOIP=y
```
